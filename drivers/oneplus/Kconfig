## drivers/oneplus/Kconfig
```kconfig
source "drivers/oneplus/coretech/Kconfig"
source "drivers/oneplus/input/Kconfig"
source "drivers/oneplus/fs/Kconfig"
source "drivers/oneplus/kernel/Kconfig"
source "drivers/oneplus/misc/Kconfig"
#source "drivers/oneplus/step_motor/Kconfig"
#source "drivers/oneplus/tri_state_key/Kconfig"
#source "drivers/oneplus/vibrator/Kconfig"
source "drivers/oneplus/power/Kconfig"
source "drivers/oneplus/vibrator/Kconfig"
#source "drivers/oneplus/power/Kconfig"
source "drivers/oneplus/oneplus_healthinfo/Kconfig"
source "drivers/oneplus/mm/Kconfig"
source "drivers/oneplus/opslalib/Kconfig"
#source "drivers/oneplus/framework/Kconfig"
source "drivers/oneplus/vl53L1/Kconfig"
source "drivers/oneplus/op_freezer/Kconfig"
source "drivers/oneplus/hung_task_enhance/Kconfig"

# Oneplus configuration options

config MACH_ONEPLUS_SM8250
	bool "Oneplus SM8250"
	depends on ARCH_QCOM
	depends on ARCH_KONA
	help
	  Support for SM8250 Oneplus variants

menu "Oneplus board selection"

	config MACH_ONEPLUS_8
		bool "Oneplus 8 board"
		depends on MACH_ONEPLUS_SM8250
		help
		  Support for Oneplus 8 variant

	config MACH_ONEPLUS_8PRO
		bool "Oneplus 8 Pro board"
		depends on MACH_ONEPLUS_SM8250
		help
		  Support for Oneplus 8 Pro variant
		  
	config MACH_ONEPLUS_8T
		bool "Oneplus 8T board"
		depends on MACH_ONEPLUS_SM8250
		help
		  Support for Oneplus 8T variant

endmenu
```
